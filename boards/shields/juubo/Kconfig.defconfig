## boards/shields/juubo/Kconfig.defconfig
```kconfig
if SHIELD_JUUBO_LEFT

config ZMK_KEYBOARD_NAME
    default "Juubo40"

config ZMK_SPLIT_ROLE_CENTRAL
    default y

endif

if SHIELD_JUUBO_LEFT || SHIELD_JUUBO_RIGHT

config ZMK_SPLIT
    default y

endif
```

## boards/shields/juubo/Kconfig.shield
```kconfig
config SHIELD_JUUBO_LEFT
    def_bool $(shields_list_contains,juubo_left)

config SHIELD_JUUBO_RIGHT
    def_bool $(shields_list_contains,juubo_right)
```
